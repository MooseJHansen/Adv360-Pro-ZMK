macro_pswd: macro_pswd{
compatible = "zmk,behavior-macro";
label = "macro_pswd";
#binding-cells = <0>;
bindings
    = <&kp LS(W)>, <&kp E>, <&kp EXCLAMATION>, <&kp N1>;
};
macro_email: macro_email{
compatible = "zmk,behavior-macro";
label = "macro_email";
#binding-cells = <0>;
bindings
    = <&kp LS(M)>, <&kp A>, <&kp R>, <&kp K>, <&kp DOT>, <&kp LS(H)>,
      <&kp AT_SIGN>, 
      <&kp DOT>, <&kp C>, <&kp O>, <&kp M>, <&macro_wait_time 500>, <&kp TAB>; 
};
macro_copy: macro_copy{
compatible = "zmk,behavior-macro";
label = "macro_copy";
#binding-cells = <0>;
bindings = <&kp LC(C)>; 
};
macro_paste: macro_paste{
compatible = "zmk,behavior-macro";
label = "macro_paste";
#binding-cells = <0>;
bindings = <&kp LC(V)>; 
};